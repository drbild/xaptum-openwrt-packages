## libs/amcl/Config.in
```kconfig
menu "Configuration"
	depends on PACKAGE_amcl

	menuconfig AMCL_RSA
		bool "RSA support"
		default y
		help
		  Include support for RSA-based cryptography.

	if AMCL_RSA

	config AMCL_RSA_2048
		bool "2048 bit"
		default y

	config AMCL_RSA_3072
		bool "3072 bit"
		default y

	config AMCL_RSA_4096
		bool "4096 bit"

	endif

	menuconfig AMCL_CURVE
		bool "ECC support"
		default y
		help
		   Include support for elliptic curve-based cryptography.

	if AMCL_CURVE

	config AMCL_CURVE_ANSSI
		bool "ANSSI"

	config AMCL_CURVE_BLS383
		bool "BLS383"

	config AMCL_CURVE_BLS461
		bool "BLS461"

	config AMCL_CURVE_BN254
		bool "BN254"

	config AMCL_CURVE_BN254CX
		bool "BN254CX"
		default y

	config AMCL_CURVE_BRAINPOOL
		bool "BRAINPOOL"

	config AMCL_CURVE_C25519
		bool "C25519"

	config AMCL_CURVE_C41417
		bool "C41417"

	config AMCL_CURVE_ED25519
		bool "ED25519"
		default y

	config AMCL_CURVE_FP256BN
		bool "FP256BN"

	config AMCL_CURVE_FP512BN
		bool "FP512BN"

	config AMCL_CURVE_GOLDILOCKS
		bool "GOLDILOCKS"
		default y

	config AMCL_CURVE_HIFIVE
		bool "HIFIVE"

	config AMCL_CURVE_NIST256
		bool "NIST256"
		default y

	config AMCL_CURVE_NIST384
		bool "NIST384"

	config AMCL_CURVE_NIST521
		bool "NIST521"

	config AMCL_CURVE_NUMS256E
		bool "NUMS256E"

	config AMCL_CURVE_NUMS256W
		bool "NUMS256W"

	config AMCL_CURVE_NUMS384E
		bool "NUMS483E"

	config AMCL_CURVE_NUMS384W
		bool "NUMS384W"

	config AMCL_CURVE_NUMS512E
		bool "NUMS512E"

	config AMCL_CURVE_NUMS512W
		bool "NUMS512W"

	endif

	config AMCL_MPIN
		bool "M-PIN support"
		default y
		depends on AMCL_CURVE_BLS461  || \
		           AMCL_CURVE_BN254   || \
		           AMCL_CURVE_BN254CX || \
		           AMCL_CURVE_FP256BN || \
		           AMCL_CURVE_FP512BN
		help
		  Include support for M-PIN, a multi-factor, zero knowledge
		  authentication protocol intended to replace the well-known
		  Username/Password authentication mechanism.

	if AMCL_MPIN

	config AMCL_MPIN_MAXPIN
		int "maximum PIN value"
		default 10000
		help
		  The maximum allowable value for an M-PIN pin.

	config AMCL_MPIN_PBLEN
		int "maximum PIN length"
		default 14
		help
		  The maximum size in bits of an M-PIN pin.

	endif

	config AMCL_WCC
		bool "WCC (Wang/Chow-Choo) support"
		default y
		depends on AMCL_CURVE_BLS383  || \
		           AMCL_CURVE_BLS461  || \
		           AMCL_CURVE_BN254   || \
		           AMCL_CURVE_BN254CX || \
		           AMCL_CURVE_FP256BN || \
		           AMCL_CURVE_FP512BN
		help
		  Include support for Wang/Chow-Choo identity-based key
		  agreement protocols.

endmenu
```

## libs/ecdaa/Config.in
```kconfig
menu "Configuration"
	depends on PACKAGE_ecdaa

	config ECDAA_TPM_SUPPORT
		bool "TPM support"
		default y
		help
		  Support using a TPM 2.0 for DAA signatures.

	config ECDAA_CURVE_BN254
		bool "BN254"
		select AMCL_CURVE_BN254

	config ECDAA_CURVE_BN254CX
		bool "BN254CX"
		select AMCL_CURVE_BN254CX

	config ECDAA_CURVE_BLS383
		bool "BLS383"
		select AMCL_CURVE_BLS383

	config ECDAA_CURVE_FP256BN
		select AMCL_CURVE_FP256BN
		bool "FP256BN"

	config ECDAA_BENCHMARKS
		bool "Benchmarks"
		default n
		help
		  Build benchmarks

	config ECDAA_TOOL
		bool "CLI Tool"
		default n
		help
		  Install CLI tool to work with DAA keys and signatures

endmenu
```

## libs/xtt/Config.in
```kconfig
menu "Configuration"
	depends on PACKAGE_xtt

	config XTT_TPM_SUPPORT
		bool "TPM support"
		default y
		help
		  Support using a TPM 2.0 for DAA signatures.

	config XTT_TOOL
		bool "CLI tool"
		default n
		help
		  Install a CLI tool to work with XTT keys and certs.

endmenu
```

## net/enftun/Config.in
```kconfig
menu "Configuration"
	depends on PACKAGE_enftun

	config ENFTUN_TPM_SUPPORT
		bool "TPM support"
		default y
		help
		  Support using a TPM 2.0 for private keys.

	config ENFTUN_XTT_SUPPORT
		bool "XTT support"
		default y
		help
		  Support using the XTT provisioning protocol.

	config ENFTUN_KEYGEN_SUPPORT
		bool "keygen utility"
		default n
		help
		  Build the enftun keygen utility

endmenu
```
